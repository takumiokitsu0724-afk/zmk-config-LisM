#include "lism.dtsi"
#include <input/processors.dtsi> // ★Input Processorsを有効にするために追加

&transform_keymap {
    col-offset = <5>;
};

// ★トラックボールのリスナーノードの中に scroller を追加する
&trackball_listener {
    scroller {
        layers = <3>;  // 有効化するレイヤーの指定
        input-processors = 
            // <&zip_xy_transform INPUT_TRANSFORM_XY_SWAP>,     // X軸とY軸の入れ替え
            <&zip_xy_transform INPUT_TRANSFORM_X_INVERT>,       // X軸反転
            <&zip_xy_to_scroll_mapper>,                         // スクロールモードに変更
            <&zip_scroll_transform INPUT_TRANSFORM_X_INVERT>,   // スクロールのX軸反転
            <&zip_scroll_scaler 1 4>;                           // ★スクロール量を1/4倍に修正
    };
};
